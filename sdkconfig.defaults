## sdkconfig.defaults
```kconfig
CONFIG_SNTP_TIME_SERVER="time.windows.com"
CONFIG_ESP_DEFAULT_CPU_FREQ_MHZ_240=y
CONFIG_ESP_DEFAULT_CPU_FREQ_MHZ=240
CONFIG_MONITOR_BAUD=115200
#CONFIG_MONITOR_BAUD=460800

CONFIG_ESPTOOLPY_FLASHFREQ_80M=y
CONFIG_FLASHMODE_QIO=y
CONFIG_ESPTOOLPY_FLASHMODE_QIO=y

CONFIG_ESPTOOLPY_FLASHFREQ="80m"
CONFIG_ESPTOOLPY_FLASHSIZE_16MB=y
CONFIG_PARTITION_TABLE_CUSTOM=y
CONFIG_PARTITION_TABLE_CUSTOM_FILENAME="partitions.csv"
CONFIG_FATFS_LFN_HEAP=y

CONFIG_ESP_MAXIMUM_RETRY=200
CONFIG_COMPILER_OPTIMIZATION_PERF=y
CONFIG_BOOTLOADER_COMPILER_OPTIMIZATION_PERF=y

CONFIG_LWIP_TCP_MSS=1440
CONFIG_TCP_MSS=1440
CONFIG_LWIP_SNTP_UPDATE_DELAY=86400000

# disable NVS
CONFIG_ESP_WIFI_NVS_ENABLED=n
CONFIG_ESP_PHY_CALIBRATION_AND_DATA_STORAGE=n
CONFIG_ESP32_PHY_CALIBRATION_AND_DATA_STORAGE=n

CONFIG_OPTIMIZATION_LEVEL_DEBUG=n
CONFIG_COMPILER_OPTIMIZATION_LEVEL_DEBUG=n
CONFIG_COMPILER_OPTIMIZATION_DEFAULT=n

CONFIG_LWIP_TCPIP_TASK_PRIO=24
CONFIG_ESP32_WIFI_AMPDU_TX_ENABLED=y
CONFIG_ESP_PHY_IRAM_OPT=y
CONFIG_ESP_WIFI_IRAM_OPT=y
CONFIG_ESP_WIFI_EXTRA_IRAM_OPT=y
CONFIG_ESP_WIFI_RX_IRAM_OPT=y
CONFIG_ESP_WIFI_SLP_IRAM_OPT=y
CONFIG_LWIP_IRAM_OPTIMIZATION=y
CONFIG_LWIP_EXTRA_IRAM_OPTIMIZATION=y
CONFIG_LWIP_TCPIP_TASK_AFFINITY=0x1

CONFIG_ESP_WIFI_DYNAMIC_TX_BUFFER_NUM=32
CONFIG_ESP_WIFI_STATIC_RX_BUFFER_NUM=16
CONFIG_ESP_WIFI_DYNAMIC_RX_BUFFER_NUM=32
CONFIG_ESP_WIFI_RX_BA_WIN=32

CONFIG_LWIP_TCP_SND_BUF_DEFAULT=28800        #10080
CONFIG_LWIP_TCP_WND_DEFAULT=28800       
CONFIG_LWIP_TCP_RECVMBOX_SIZE=16
CONFIG_LWIP_TCPIP_RECVMBOX_SIZE=32
CONFIG_LWIP_MAX_UDP_PCBS=16
CONFIG_LWIP_UDP_RECVMBOX_SIZE=16

CONFIG_ESP_WIFI_TASK_PINNED_TO_CORE_0=y

CONFIG_SPIRAM=y
CONFIG_SPIRAM_MODE_OCT=y
CONFIG_SPIRAM_SPEED_80M=y
CONFIG_SPIRAM_SPEED=80
CONFIG_SPIRAM_ALLOW_BSS_SEG_EXTERNAL_MEMORY=n

CONFIG_ESP32S3_INSTRUCTION_CACHE_16KB=y
CONFIG_SPIRAM_RODATA=y

CONFIG_IDF_INIT_VERSION="6.0.2"
```
